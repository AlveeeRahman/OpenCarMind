## main/Kconfig.projbuild
```kconfig
menu "OBD Logger Configuration"

    menu "LELink / OBD adapter"
        config OBD_BLE_NAME_PREFIXES
            string "Adapter name prefixes used for first-time discovery (comma separated)"
            default "OBDBLE,OBDII,OBD2,OBDLink,ELM327,VEEPEAK,vLinker,V-LINK,IOS-Vlink,Vgate,iCar,Viecar,KONNWEI"
            help
                Case-insensitive prefixes matched against the advertised device name
                when no adapter address has been saved yet. Names that contain a
                common adapter word (OBD, ELM327, Vgate, vLink, Veepeak, Carista,
                Kiwi, LELink, ...) and adverts with an OBD serial service are found
                without this list. A device that matches but is not an adapter is
                skipped for 10 minutes when it has no serial service or does not
                answer the ELM327 reset. Add your adapter's name here if it is not
                found. The adapter's address is stored in NVS once it answers ATZ,
                and later boots connect to that address only.

        config OBD_BLE_SVC_UUID
            string "GATT service UUID (hex, 16-bit or 128-bit, empty = auto-detect)"
            default "FFE0"
        config OBD_BLE_NOTIFY_UUID
            string "Notify characteristic UUID (hex, empty = auto-detect)"
            default "FFE1"
        config OBD_BLE_WRITE_UUID
            string "Write characteristic UUID (hex, empty = auto-detect)"
            default "FFE1"
        config OBD_BLE_MIN_RSSI
            int "Minimum RSSI (dBm) to attempt a connection"
            default -90

        config OBD_POLL_INTERVAL_MS
            int "Delay between PID polling cycles (ms)"
            default 200
        config OBD_SLOW_GROUP_EVERY
            int "Poll slow-changing PIDs every N cycles"
            default 5
        config OBD_DTC_INTERVAL_S
            int "Read MIL status and DTCs every N seconds"
            default 60
        config OBD_RAW_EVERY_PASSES
            int "Sample PIDs without a decoder every N passes through the slow list"
            range 1 100
            default 10
            help
                Supported PIDs that the firmware cannot decode are logged raw
                (uptime, PID, hex) in the session's .raw file. Raw sampling takes
                one request per polling cycle during every Nth pass, so a lower
                number samples more often and slows the main rows a little.
                Newer cars report many PIDs without a decoder, so lower this if
                you want more of them.
        config OBD_ELM_TIMEOUT_MS
            int "Per-command response timeout (ms)"
            default 2500
    endmenu

    menu "SD card logging"
        config SDLOG_MOUNT_POINT
            string "Mount point"
            default "/sdcard"
        config SDLOG_FSYNC_EVERY_ROWS
            int "fsync() the CSV after at most N rows"
            default 25
        config SDLOG_SYNC_PERIOD_S
            int "Save everything to the card at least every N seconds"
            default 10
            range 1 60
            help
                Every N seconds, and when the car link drops, the CSV, raw, pattern and model files and the session JSON
                are flushed to the card and the board raises the event "Safe to turn off". Power cut at a random moment
                loses at most N seconds of the drive.
        config SDLOG_FORMAT_IF_MOUNT_FAILED
            bool "Format the card if it cannot be mounted (DESTRUCTIVE)"
            default n
        config OCM_STORAGE_RESET_TEST
            bool "ESP-Mosaico test: storage reset-injection loop (DESTROYS the log storage)"
            depends on IDF_TARGET_ESP32S31
            default n
            help
                Bench test of the flash FAT against abnormal resets. Every boot checks the volume the previous cycle left,
                then writes and appends small files and resets the board at a random moment (esp_restart, abort with a
                core dump, the download door's ROM reset), or with the stall variant freezes the UI so the ui-stall
                guard fires. After a volume loss it erases the storage partition. Counters are kept in NVS ("srt") and
                printed as "SRT ..." lines. Never in a release or a car build.
        config OCM_STORAGE_RESET_TEST_CYCLES
            int "Reset cycles per run"
            depends on OCM_STORAGE_RESET_TEST
            default 200
        config OCM_STORAGE_RESET_TEST_STALL
            bool "Stall variant: freeze the UI so the ui-stall guard resets the board"
            depends on OCM_STORAGE_RESET_TEST
            default n
        config OCM_NAND_LOGS
            bool "ESP-Mosaico: drive logs on the 128 MB SPI NAND"
            depends on IDF_TARGET_ESP32S31
            default y
            help
                The ESP-Mosaico core board carries a GigaDevice GD5F1GM7UEYIGR (1 Gbit, 3.3 V) SPI NAND on GPIO20-25.
                With this option the drive logs (sNNNNNN.* and drives.csv) are written to a FAT on it (Dhara wear
                levelling, espressif/spi_nand_flash), and the flash FAT keeps the state files. A blank NAND is formatted
                at the first boot; drive logs found on the flash FAT are moved to it once. Without a working NAND the
                logs stay on the flash FAT.
        config OCM_NAND_MOUNT_POINT
            string "NAND mount point"
            depends on OCM_NAND_LOGS
            default "/nand"
        config OCM_NAND_SPI_MHZ
            int "NAND SPI clock (MHz)"
            depends on OCM_NAND_LOGS
            range 1 80
            default 20
            help
                SPI3 through the GPIO matrix (the NAND pins are SPI2's IO MUX set, but SPI2 drives the display).
                Half duplex: the driver adds dummy cycles for the matrix input delay.
        config OCM_NAND_QIO
            bool "NAND in quad I/O (WP# and HOLD# as data lines)"
            depends on OCM_NAND_LOGS
            default n
            help
                Off: single-line SPI with WP# and HOLD# held high as GPIOs. On: quad reads and writes (the driver sets
                the chip's QE bit). Untested on the board.
        config OCM_NAND_SELFTEST
            bool "Bench: NAND speed self-test at boot (writes and deletes 1 MB)"
            depends on OCM_NAND_LOGS
            default n
            help
                After the mount: 1 MB written in 16 KB chunks and synced, read back and compared, then 200 drive-like
                1 KB appends with an fsync every 25; prints "NAND selftest: write N KB/s, read N KB/s, fsync p50/max ms".
                Test builds only.
    endmenu

    menu "Wi-Fi clock sync"
        config OCM_WIFI_CLOCK_SYNC
            bool "Set the clock over Wi-Fi from one verified HTTPS time server when a known network is in reach"
            default y
            help
                Compiles the Wi-Fi module in. When off, Wi-Fi is never started and the clock stays unset (session files
                carry epoch 0) unless the RTC kept a time through a reset.
        config OCM_TIME_HTTPS_HOST
            string "The one time server (host name, HTTPS)"
            depends on OCM_WIFI_CLOCK_SYNC
            default "www.google.com"
            help
                The board sends one HTTPS HEAD request to this host and takes the time from the Date header of the reply.
                The server must present a certificate for exactly this name that chains to a root in ESP-IDF's common
                certificate bundle; any other server, or a time outside 2026-2099, is refused. Nothing else is sent: no
                SNTP, no upload. Point it at a server you run if you prefer (set it in your own sdkconfig).
        config OCM_WIFI_UPLOAD
            bool "Send drives to the paired desktop app over Wi-Fi (off: in the works, see README)"
            depends on OCM_WIFI_CLOCK_SYNC
            default n
            help
                Off by default in 2.5.x: Wi-Fi only sets the clock, and drives reach the desktop app over the USB cable.
                The upload is being reworked into a transfer without head-of-line blocking. Pairing over USB still works
                and still protects the USB commands.
        config SYNC_WIFI_SSID
            string "Fallback Wi-Fi SSID (optional; networks normally come from wifi.csv on the SD card)"
            depends on OCM_WIFI_CLOCK_SYNC
            default ""
            help
                Anything you type here is stored in plain text in sdkconfig and in the firmware image. Prefer wifi.csv.
        config SYNC_WIFI_PASSWORD
            string "Fallback Wi-Fi password (optional)"
            depends on OCM_WIFI_CLOCK_SYNC
            default ""
        config SYNC_WIFI_MIN_RSSI
            int "Only connect when the AP RSSI is above this (dBm)"
            depends on OCM_WIFI_CLOCK_SYNC
            default -75
        config SYNC_SCAN_INTERVAL_S
            int "Seconds between scans while the clock has never been set"
            depends on OCM_WIFI_CLOCK_SYNC
            default 20
            help
                The board only uses Wi-Fi to set its clock over SNTP. Until the clock is set it looks for a known network
                this often (never while the car is being logged).
        config SYNC_STAY_CONNECTED_S
            int "Seconds to stay connected after a successful clock sync"
            depends on OCM_WIFI_CLOCK_SYNC
            range 5 600
            default 30
            help
                After the clock is set the board disconnects so the radio stops competing with BLE.
        config SYNC_RESYNC_INTERVAL_H
            int "Hours between clock re-syncs once the clock is set"
            depends on OCM_WIFI_CLOCK_SYNC
            range 1 168
            default 6
            help
                Corrects crystal drift. If no known network is in reach when a re-sync is due, the board tries again every
                15 minutes.
        config SYNC_TIMEZONE
            string "POSIX timezone string for the clock"
            default "UTC0"
            help
                Examples: "CST6CDT,M3.2.0,M11.1.0" (US Central), "EST5EDT,M3.2.0,M11.1.0" (US Eastern), "PST8PDT,M3.2.0,M11.1.0" (US Pacific),
                "CET-1CEST,M3.5.0,M10.5.0/3" (central Europe), "UTC0".
    endmenu

    menu "Display"
        config LCD_INVERT_COLORS
            bool "Invert panel colors"
            default y
            help
                Toggle if the dashboard shows inverted colors on your panel revision.
        config LCD_BACKLIGHT_PCT
            int "Backlight brightness (0-100)"
            range 0 100
            default 80
        config OCM_SWIPE_INTENT
            bool "Smart swipe: learn where launcher swipes go and start them sooner (keeps itself only if faster)"
            depends on IDF_TARGET_ESP32S31
            default y
            help
                A 1.3 KB on-device learner (main/swipe_intent.c, OS-ELM with recursive least squares) predicts
                40 ms after touch-down whether a launcher gesture goes to the next page, the previous page or stays.
                It never triggers an action: on the gestures where it may act it keeps the Home picture current
                and starts LVGL's own snap at the lift. It starts in an interleaved A/B test and, after at least
                50 swipes per arm, keeps itself only if lift-to-settled p95 dropped and the predicted page was
                ready at lift on more than 80 % of swipes; otherwise it turns itself off. The verdict is saved in
                NVS (about 840 B) and re-tested after a firmware update or a settings reset. Settings shows the state.
        config OCM_UI_METRICS
            bool "Smart UI: measure finger-lift to page-settled for every touch, and gate any prefetch per class"
            depends on IDF_TARGET_ESP32S31
            default y
            help
                main/ui_metrics.c times every launcher swipe, app-icon tap, Back, in-app control and list scroll from
                the finger lift to the moment the page has settled (its last frame drawn and nothing left to draw for
                two refresh periods), keeps per-class histograms, and runs the A/B gate that decides per class whether
                a prefetcher may stay: p95 must drop, the prefetched page must be ready on more than 80 % of events and
                a one-sided Mann-Whitney test (Holm-corrected across the classes) must pass, else it is turned off.
                The verdicts are saved in NVS and re-tested after a firmware update. About 3 KB of PSRAM.
        config OCM_UI_PREFETCH
            bool "Smart UI arm A1: build the app (or refresh the launcher) at the press, keep it only if faster"
            depends on OCM_UI_METRICS
            default y
            help
                At the press on an app icon the app screen is built in a spare screen, and at the press on Back the
                launcher behind the app is refreshed, so the click only has to show it. On half of the taps of each
                class (after a warm-up) the gate compares it with no prefetch and keeps it only by the Smart UI rule;
                otherwise it turns it off for that class. The click still decides where the page goes.
    endmenu
    menu "Diagnostics"
        config CARMIND_TASK_STATS_S
            int "Log per-task CPU, stack and heap every N seconds (0 = off)"
            range 0 3600
            default 0
            help
                For finding a task that hogs a core, a stack close to overflow, or memory that leaks. Off in normal
                builds: it adds about 30 log lines per dump.
    endmenu

    menu "On-board model"
        config CARMIND_ML_ENABLE
            bool "Run the manoeuvre and estimator model on a sliding window (ML_WINDOW seconds, from ml_params.h)"
            default y
            help
                Loads ml/onboard/onboard.espdl (ESP-DL) at boot and writes one line per pattern window to
                sNNNNNN.ml.csv. Regenerate main/ml_params.h with tools/gen_ml_params.py when the model changes.
        config CARMIND_ML_SELFTEST
            bool "Run the model's embedded self-test and one timed inference at boot"
            depends on CARMIND_ML_ENABLE
            default y
        config CARMIND_ML_STRIDE_S
            int "Run the model every N seconds on a sliding window (ML_WINDOW seconds, from ml_params.h) (0 = once per 10 s pattern window)"
            depends on CARMIND_ML_ENABLE
            range 0 10
            default 1
            help
                Soft real-time: the model needs about 6 to 16 ms, so one inference per second costs about 1 to 2 percent of a
                core. With N > 0 the rows in sNNNNNN.ml.csv are keyed by an inference counter in window_seq; join to the .pat
                windows by start_ms and end_ms.
        config CARMIND_ML_HOLD_S
            int "Keep a channel's last value for up to N seconds when no new sample arrived (0 = off)"
            depends on CARMIND_ML_ENABLE
            range 0 10
            default 3
            help
                The training loader resamples to 1 Hz with last-value-carried-forward, so a slow channel (coolant, fuel trims)
                that was read a few seconds ago is still valid input. Older than N seconds counts as missing.
        config CARMIND_ML_SYNTH_TEST
            bool "Bench test: feed a synthetic 100 s drive through the inference path at boot"
            depends on CARMIND_ML_ENABLE
            default n
            help
                Writes 10 windows (window_seq 990000+) to the current session's .ml.csv. Never enable in a car build.
        config CARMIND_REV_ENABLE
            bool "CarMind R.E.V: embed the second model and its on-board fuel learning"
            depends on CARMIND_ML_ENABLE
            default y
            help
                Embeds ml/onboard/rev/onboard.espdl (about 64 KB of flash) next to CarMind E.V. The desktop app switches
                between the two over USB; E.V stays the default until the user picks R.E.V. While R.E.V runs, the board learns
                this car's fuel use (a new read-out of the model's z feature, see rev_learn.h). Say n for an E.V-only firmware;
                the app then shows R.E.V as not available.
        config CARMIND_REV_PHYS
            bool "R.E.V: learn the airflow constant (polls PID 0x43 in every cycle while R.E.V runs)"
            depends on CARMIND_REV_ENABLE
            default y
            help
                MAF = k x absolute load x rpm, with k learned while MAF is reported and used when it is not. Absolute load
                joins the fast PIDs, which adds one adapter transaction per row on cars that report it. Cars without PID 0x43
                learn from calculated load (0x04) per rpm bin instead: EXPERIMENTAL, not yet tested on data.
        config CARMIND_REV_CAL
            bool "Fill-up calibration of every fuel source"
            depends on CARMIND_ML_ENABLE
            default y
            help
                One factor from the fill-ups entered in the desktop app (litres pumped against litres counted), applied to
                every fuel figure for both models. Without fill-ups the factor is 1 and nothing changes.
        config CARMIND_REV_SAVE_MIN
            int "Save the learned state at most every N minutes while driving"
            depends on CARMIND_REV_ENABLE || CARMIND_REV_CAL
            range 1 60
            default 5
            help
                /sdcard/obd/rev_state.bin, about 20 KB, is also saved when a drive ends, after a fill-up and before power-off.
    endmenu
endmenu
```
